## drivers/mihw/Kconfig
```kconfig
config MILLET
	bool "Mi frozen framework"
	depends on MIHW
	default n
	help
	  Xiaomi frozen framework: reports binder, signal, package and
	  freezer cgroup events to a userspace monitor over NETLINK_MILLET.
```
